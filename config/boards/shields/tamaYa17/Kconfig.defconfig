## config/boards/shields/tamaYa17/Kconfig.defconfig
```kconfig
if SHIELD_TAMAYA17_L

config ZMK_KEYBOARD_NAME
    default "tamaYa17_L"

config ZMK_SPLIT
    default y

config ZMK_SPLIT_ROLE_CENTRAL
    default y

endif

if SHIELD_TAMAYA17_R

config ZMK_KEYBOARD_NAME
    default "tamaYa17_R"

config ZMK_SPLIT
    default y

endif
```

## config/boards/shields/tamaYa17/Kconfig.shield
```kconfig
config SHIELD_TAMAYA17_R
    def_bool $(shields_list_contains,tamaYa17_R)

config SHIELD_TAMAYA17_L
    def_bool $(shields_list_contains,tamaYa17_L)
```
